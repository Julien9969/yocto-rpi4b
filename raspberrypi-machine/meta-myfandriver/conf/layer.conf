## raspberrypi-machine/meta-myfandriver/conf/layer.conf
```bitbake
# We have a conf and classes directory, add to BBPATH
BBPATH .= ":${LAYERDIR}"

# We have recipes-* directories, add to BBFILES
BBFILES += "${LAYERDIR}/recipes-*/*/*.bb \
            ${LAYERDIR}/recipes-*/*/*.bbappend"

BBFILE_COLLECTIONS += "meta-myfandriver"
BBFILE_PATTERN_meta-myfandriver = "^${LAYERDIR}/"
BBFILE_PRIORITY_meta-myfandriver = "6"

LAYERDEPENDS_meta-myfandriver = "core"
LAYERSERIES_COMPAT_meta-myfandriver = "kirkstone"
```
